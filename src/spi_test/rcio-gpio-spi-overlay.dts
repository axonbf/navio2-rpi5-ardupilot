/dts-v1/;
/plugin/;

/ {
    compatible = "brcm,bcm2712";

    fragment@0 {
        target-path = "/";
        __overlay__ {
            rcio_gpio_spi: spi-gpio-rcio {
                compatible = "spi-gpio";
                #address-cells = <1>;
                #size-cells = <0>;
                num-chipselects = <1>;
                sck-gpios = <&gpio 21 0>;
                miso-gpios = <&gpio 19 0>;
                mosi-gpios = <&gpio 20 0>;
                cs-gpios = <&gpio 16 1>;
                status = "okay";

                rcio@0 {
                    compatible = "rcio";
                    reg = <0>;
                    spi-max-frequency = <100000>;
                    status = "okay";
                };
            };
        };
    };
};
